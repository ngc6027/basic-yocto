## yocto/layers/meta-basic-zedboard/conf/layer.conf
```bitbake
# We have a conf and classes directory, add to BBPATH
BBPATH .= ":${LAYERDIR}"

# We have recipes-* directories, add to BBFILES
BBFILES += "${LAYERDIR}/recipes-*/*/*.bb \
            ${LAYERDIR}/recipes-*/*/*.bbappend"

BBFILE_COLLECTIONS += "meta-basic-zedboard"
BBFILE_PATTERN_meta-basic-zedboard = "^${LAYERDIR}/"
BBFILE_PRIORITY_meta-basic-zedboard = "6"

LAYERVERSION_meta-basic-zedboard = "1"

LAYERDEPENDS_meta-basic-zedboard = "core"
LAYERSERIES_COMPAT_meta-basic-zedboard = "gatesgarth"
```
